## components/web_server/Kconfig.projbuild
```kconfig
menu "Web Server / WiFi"

    config WEB_SERVER_MDNS_HOSTNAME
        string "mDNS hostname"
        default "cyd-logger"
        help
            Device answers at http://<hostname>.local on the LAN once
            connected.

            WiFi network credentials are not configured here — they're
            provisioned at runtime (SoftAP + captive portal on first boot
            or whenever the stored network can't be reached; see
            components/web_server/wifi_provision.c) and stored in NVS on
            the device, never in this build.

endmenu
```

## sdkconfig.defaults
```kconfig
CONFIG_IDF_TARGET="esp32"
CONFIG_ESPTOOLPY_FLASHSIZE_4MB=y
CONFIG_PARTITION_TABLE_CUSTOM=y
CONFIG_PARTITION_TABLE_CUSTOM_FILENAME="partitions.csv"
CONFIG_PARTITION_TABLE_FILENAME="partitions.csv"
CONFIG_LV_USE_OBSERVER=y
CONFIG_LV_THEME_DEFAULT_DARK=y
CONFIG_LV_FONT_MONTSERRAT_20=y
CONFIG_LV_FONT_MONTSERRAT_28=y
CONFIG_LV_FONT_MONTSERRAT_40=y
```
